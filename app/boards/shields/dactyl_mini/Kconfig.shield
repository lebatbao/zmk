## app/boards/shields/dactyl_mini/Kconfig.shield
```kconfig
config SHIELD_DACTYL_MINI_LEFT
    def_bool $(shields_list_contains,dactyl_mini_left)

config SHIELD_DACTYL_MINI_RIGHT
    def_bool $(shields_list_contains,dactyl_mini_right)
```
